## sdkconfig.defaults
```kconfig
# CYT-NG Handheld — ESP32-S3 sdkconfig defaults

# Target
CONFIG_IDF_TARGET="esp32s3"

# CPU frequency
CONFIG_ESP_DEFAULT_CPU_FREQ_MHZ_240=y

# PSRAM (8MB octal SPI on T-Display-S3)
CONFIG_SPIRAM=y
CONFIG_SPIRAM_MODE_OCT=y
CONFIG_SPIRAM_SPEED_80M=y
CONFIG_SPIRAM_USE_MALLOC=y

# WiFi
CONFIG_ESP_WIFI_ENABLE_WPA3_SAE=y
CONFIG_ESP_WIFI_SOFTAP_SUPPORT=y

# Bluetooth
CONFIG_BT_ENABLED=y
CONFIG_BT_NIMBLE_ENABLED=y
CONFIG_BT_NIMBLE_MAX_CONNECTIONS=1
CONFIG_BT_NIMBLE_EXT_ADV=y

# Software coexistence (WiFi + BLE share radio)
CONFIG_ESP_COEX_SW_COEXIST_ENABLE=y

# FreeRTOS
CONFIG_FREERTOS_HZ=1000
CONFIG_FREERTOS_CHECK_STACKOVERFLOW_CANARY=y

# Stack sizes
CONFIG_ESP_MAIN_TASK_STACK_SIZE=8192

# USB (for serial upload to base station)
CONFIG_TINYUSB_CDC_ENABLED=y

# Logging
CONFIG_LOG_DEFAULT_LEVEL_INFO=y

# Partition table — custom for larger app + storage
CONFIG_PARTITION_TABLE_CUSTOM=y
CONFIG_PARTITION_TABLE_CUSTOM_FILENAME="partitions.csv"
```
